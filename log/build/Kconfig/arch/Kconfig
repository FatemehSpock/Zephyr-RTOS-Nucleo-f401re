## log/build/Kconfig/arch/Kconfig
```kconfig
# Load Zephyr Arch Kconfig descriptions.
osource "/home/nazanin/zephyrproject/zephyr/arch/x86/Kconfig"
osource "/home/nazanin/zephyrproject/zephyr/arch/xtensa/Kconfig"
osource "/home/nazanin/zephyrproject/zephyr/arch/sparc/Kconfig"
osource "/home/nazanin/zephyrproject/zephyr/arch/riscv/Kconfig"
osource "/home/nazanin/zephyrproject/zephyr/arch/posix/Kconfig"
osource "/home/nazanin/zephyrproject/zephyr/arch/nios2/Kconfig"
osource "/home/nazanin/zephyrproject/zephyr/arch/mips/Kconfig"
osource "/home/nazanin/zephyrproject/zephyr/arch/arm64/Kconfig"
osource "/home/nazanin/zephyrproject/zephyr/arch/arm/Kconfig"
osource "/home/nazanin/zephyrproject/zephyr/arch/arc/Kconfig"
```

## log/build/Kconfig/boards/Kconfig
```kconfig
# Load Zephyr board Kconfig descriptions.
osource "/home/nazanin/zephyrproject/zephyr/boards/st/nucleo_f401re/Kconfig"
```

## log/build/Kconfig/boards/Kconfig.defconfig
```kconfig
# Load Zephyr board defconfig descriptions.
osource "/home/nazanin/zephyrproject/zephyr/boards/st/nucleo_f401re/Kconfig.defconfig"
```

## log/build/Kconfig/boards/Kconfig.sysbuild
```kconfig
# Load Sysbuild board Kconfig descriptions.
osource "/home/nazanin/zephyrproject/zephyr/boards/st/nucleo_f401re/Kconfig.sysbuild"
```
