## prj.conf
```kconfig
CONFIG_SERIAL=y
CONFIG_UART_CONSOLE=y
CONFIG_GPIO=y
CONFIG_LOG=y
CONFIG_USE_SEGGER_RTT=y
CONFIG_LOG_BACKEND_RTT=y
```

## nucleo_f401re.overlay
```dts
&usart2 {
    current-speed = <9600>;  // Change this to your desired baud rate
};
```

## src/main.c
```c
#include <zephyr/kernel.h>
#include <zephyr/logging/log.h>

LOG_MODULE_REGISTER(main, LOG_LEVEL_NONE);
int main(void) {
    LOG_ERR("Error: Hello World");
    LOG_INF("Info: Hello World");
    LOG_WRN("Warn: Hello World");
    LOG_DBG("Debug: Hello World");
    /* Allow time for logs to flush */
    k_sleep(K_MSEC(500));
return 0;
}
```
